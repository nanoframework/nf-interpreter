## Kconfig
```kconfig
#
# Copyright (c) .NET Foundation and Contributors
# See LICENSE file in the project root for full license information.
#

mainmenu ".NET nanoFramework Configuration"

config TARGET_BOARD
    string "Target board name"

config TARGET_SERIES
    string "Target MCU series"

source "Kconfig.rtos"
source "Kconfig.build"
source "Kconfig.features"
source "Kconfig.apis"
source "Kconfig.graphics"
source "Kconfig.networking"
source "Kconfig.serial"
source "Kconfig.wireprotocol"

# Platform-specific Kconfig files
source "targets/ESP32/Kconfig"
source "targets/ChibiOS/Kconfig"
source "targets/FreeRTOS/Kconfig"
source "targets/TI_SimpleLink/Kconfig"
source "targets/ThreadX/Kconfig"
```

## Kconfig.apis
```kconfig
#
# Copyright (c) .NET Foundation and Contributors
# See LICENSE file in the project root for full license information.
#

menu "nanoFramework APIs"

config API_SYSTEM_MATH
    bool "System.Math"
    default y

config API_SYSTEM_NET
    bool "System.Net"
    default n
    select NF_FEATURE_HAS_CONFIG_BLOCK
    select NF_SECURITY_MBEDTLS

config API_SYSTEM_DEVICE_GPIO
    bool "System.Device.Gpio"
    default y

config API_SYSTEM_DEVICE_SPI
    bool "System.Device.Spi"
    default n

config API_SYSTEM_DEVICE_I2C
    bool "System.Device.I2c"
    default n

config API_SYSTEM_DEVICE_I2C_SLAVE
    bool "System.Device.I2c.Slave"
    depends on API_SYSTEM_DEVICE_I2C
    default n

config API_SYSTEM_DEVICE_PWM
    bool "System.Device.Pwm"
    default n

config API_SYSTEM_DEVICE_ADC
    bool "System.Device.Adc"
    default n

config API_SYSTEM_DEVICE_DAC
    bool "System.Device.Dac"
    default n

config API_SYSTEM_DEVICE_I2S
    bool "System.Device.I2s"
    default n

config API_SYSTEM_DEVICE_WIFI
    bool "System.Device.Wifi"
    default n

config API_SYSTEM_DEVICE_USBSTREAM
    bool "System.Device.UsbStream"
    default n

config API_SYSTEM_IO_PORTS
    bool "System.IO.Ports"
    default n
    select API_NANOFRAMEWORK_SYSTEM_TEXT

config API_SYSTEM_IO_FILESYSTEM
    bool "System.IO.FileSystem"
    depends on NF_FEATURE_HAS_SDCARD || NF_FEATURE_USE_LITTLEFS
    default n

config API_NANOFRAMEWORK_DEVICE_ONEWIRE
    bool "nanoFramework.Device.OneWire"
    default n

config API_NANOFRAMEWORK_DEVICE_CAN
    bool "nanoFramework.Device.Can"
    default n

config API_NANOFRAMEWORK_DEVICE_BLUETOOTH
    bool "nanoFramework.Device.Bluetooth"
    default n

config API_NANOFRAMEWORK_GRAPHICS
    bool "nanoFramework.Graphics"
    default n

config API_NANOFRAMEWORK_RESOURCEMANAGER
    bool "nanoFramework.ResourceManager"
    default n

config API_NANOFRAMEWORK_SYSTEM_COLLECTIONS
    bool "nanoFramework.System.Collections"
    default n

config API_NANOFRAMEWORK_SYSTEM_TEXT
    bool "nanoFramework.System.Text"
    default n

config API_NANOFRAMEWORK_SYSTEM_SECURITY_CRYPTOGRAPHY
    bool "nanoFramework.System.Security.Cryptography"
    depends on NF_SECURITY_MBEDTLS
    default n

config API_NANOFRAMEWORK_SYSTEM_IO_HASHING
    bool "nanoFramework.System.IO.Hashing"
    default n

config API_NANOFRAMEWORK_NETWORKING_THREAD
    bool "nanoFramework.Networking.Thread"
    default n

# Platform-specific APIs — visible only when the relevant RTOS is selected

config API_HARDWARE_STM32
    bool "Hardware.Stm32"
    depends on RTOS_CHIBIOS
    default n

config API_HARDWARE_ESP32
    bool "Hardware.Esp32"
    depends on RTOS_ESP32
    default y if RTOS_ESP32

config API_NANOFRAMEWORK_HARDWARE_ESP32_RMT
    bool "nanoFramework.Hardware.Esp32.Rmt"
    depends on RTOS_ESP32
    default n

config API_NANOFRAMEWORK_HARDWARE_TI
    bool "nanoFramework.Hardware.TI"
    depends on RTOS_TI_SIMPLELINK
    default n

config API_NANOFRAMEWORK_TI_EASYLINK
    bool "nanoFramework.TI.EasyLink"
    depends on RTOS_TI_SIMPLELINK
    default n

config API_HARDWARE_GIANTGECKO
    bool "Hardware.GiantGecko"
    depends on RTOS_THREADX
    default n

config API_NANOFRAMEWORK_GIANTGECKO_ADC
    bool "nanoFramework.GiantGecko.Adc"
    depends on RTOS_THREADX
    default n

# Internal (hidden) API symbols — auto-selected by dependency rules

config API_NANOFRAMEWORK_RUNTIME_EVENTS
    bool
    default y if API_SYSTEM_DEVICE_GPIO || API_SYSTEM_NET || API_SYSTEM_IO_PORTS || API_NANOFRAMEWORK_DEVICE_ONEWIRE || API_NANOFRAMEWORK_DEVICE_CAN || API_SYSTEM_IO_FILESYSTEM

config API_NANOFRAMEWORK_NETWORKING_SNTP
    bool
    default y if API_SYSTEM_NET && NF_NETWORKING_SNTP

config API_SYSTEM_RUNTIME_SERIALIZATION
    bool
    default y if NF_FEATURE_SUPPORT_REFLECTION && NF_FEATURE_BINARY_SERIALIZATION

endmenu
```

## Kconfig.build
```kconfig
#
# Copyright (c) .NET Foundation and Contributors
# See LICENSE file in the project root for full license information.
#

menu "Build Options"

config NF_BUILD_RTM
    bool "Build RTM firmware (suppresses debug output)"
    default n

config NF_TARGET_HAS_NANOBOOTER
    bool "Target includes nanoBooter"
    default y

config NF_DOUBLE_PRECISION_FP
    bool "Double-precision floating point"
    default n

config NF_FEATURE_LIGHT_MATH
    bool "Light math (exclude complex math functions)"
    default n

config NF_SUPPORT_ANY_BASE_CONVERSION
    bool "String conversion to any numeric base"
    default n

config NF_FEATURE_USE_RNG
    bool "Hardware true random number generator"
    default y

config NF_SECURITY_MBEDTLS
    bool "Mbed TLS support"
    default y

config NF_PLATFORM_NO_CLR_TRACE
    bool "Disable all CLR trace messages and checks"
    default n

config NF_CLR_NO_IL_INLINE
    bool "Disable CLR IL inlining"
    default n

config STM32_CUBE_PACKAGE_REQUIRED
    bool "STM32 Cube package required"
    depends on RTOS_CHIBIOS || RTOS_THREADX
    default n

endmenu
```

## Kconfig.features
```kconfig
#
# Copyright (c) .NET Foundation and Contributors
# See LICENSE file in the project root for full license information.
#

menu "nanoFramework Features"

# Naming convention for NF_FEATURE_* symbols
# -------------------------------------------
# NF_FEATURE_HAS_*  — declares that a hardware capability is present on the
#                     target board (e.g. an SD-card slot, a config-block flash
#                     partition, accessible storage).  Selecting the symbol does
#                     not imply any particular software stack; it merely tells
#                     the build system that the hardware resource exists.
#
# NF_FEATURE_USE_*  — selects a software feature or stack that the firmware
#                     should include (e.g. LittleFS, Application Domains).
#                     The hardware required by the feature is assumed to be
#                     present independently (often gated by a HAS_ symbol).
#
# Other NF_FEATURE_* symbols (no HAS_/USE_ infix) represent features that are
# neither purely hardware-presence flags nor pure software choices (e.g.
# DEBUGGER, WATCHDOG, SUPPORT_REFLECTION).

config NF_FEATURE_DEBUGGER
    bool "Managed application debugging support"
    default y

config NF_FEATURE_RTC
    bool "Hardware RTC support"
    default n

config NF_FEATURE_HAS_SDCARD
    bool "SD Card support"
    default n
    select API_SYSTEM_IO_FILESYSTEM

config NF_FEATURE_HAS_CONFIG_BLOCK
    bool "Configuration block storage"
    default n

config NF_FEATURE_USE_LITTLEFS
    bool "LittleFS file system"
    default n
    select API_SYSTEM_IO_FILESYSTEM

config NF_FEATURE_HAS_ACCESSIBLE_STORAGE
    bool "Accessible storage (internal storage)"
    default n

config NF_FEATURE_HAS_USB_MSD
    bool "USB Mass Storage"
    default n
    select API_SYSTEM_IO_FILESYSTEM

config NF_FEATURE_WATCHDOG
    bool "Hardware watchdog"
    default y

config NF_FEATURE_SUPPORT_REFLECTION
    bool "System.Reflection API support"
    default y

config NF_FEATURE_BINARY_SERIALIZATION
    bool "Binary serialization support"
    default y

config NF_FEATURE_USE_APPDOMAINS
    bool "Application Domains support"
    default n

config NF_FEATURE_LIGHT_MATH
    bool "Light math (exclude complex math functions)"
    default n

config NF_TRACE_TO_STDIO
    bool "Send trace data to stdio (requires spare SERIAL device)"
    default n

endmenu
```

## Kconfig.graphics
```kconfig
#
# Copyright (c) .NET Foundation and Contributors
# See LICENSE file in the project root for full license information.
#

menu "Graphics"
    depends on API_NANOFRAMEWORK_GRAPHICS

choice GRAPHICS_DISPLAY_DRIVER
    prompt "Display driver"

config GRAPHICS_DISPLAY_ILI9341
    bool "ILI9341"

config GRAPHICS_DISPLAY_ILI9342
    bool "ILI9342"

config GRAPHICS_DISPLAY_ST7735S
    bool "ST7735S"

config GRAPHICS_DISPLAY_ST7789V
    bool "ST7789V"

config GRAPHICS_DISPLAY_GC9A01
    bool "GC9A01"

config GRAPHICS_DISPLAY_OTM8009A
    bool "Otm8009a (DSI Video Mode)"

config GRAPHICS_DISPLAY_GENERIC_SPI
    bool "Generic SPI"

endchoice

config GRAPHICS_DISPLAY
    string
    default "ILI9341_240x320_SPI.cpp"           if GRAPHICS_DISPLAY_ILI9341
    default "ILI9342_320x240_SPI.cpp"           if GRAPHICS_DISPLAY_ILI9342
    default "ST7735S_SPI.cpp"                   if GRAPHICS_DISPLAY_ST7735S
    default "ST7789V_240x320_SPI.cpp"           if GRAPHICS_DISPLAY_ST7789V
    default "GC9A01_240x240_SPI.cpp"            if GRAPHICS_DISPLAY_GC9A01
    default "Otm8009a_DSI_Video_Mode.cpp"       if GRAPHICS_DISPLAY_OTM8009A
    default "Generic_SPI.cpp"                   if GRAPHICS_DISPLAY_GENERIC_SPI

choice GRAPHICS_DISPLAY_INTERFACE_CHOICE
    prompt "Display interface"

config GRAPHICS_IFACE_SPI
    bool "SPI to Display"

config GRAPHICS_IFACE_DSI_VIDEO
    bool "DSI Video Mode"

endchoice

config GRAPHICS_DISPLAY_INTERFACE
    string
    default "Spi_To_Display.cpp"                if GRAPHICS_IFACE_SPI
    default "DSI_To_Display_Video_Mode.cpp"     if GRAPHICS_IFACE_DSI_VIDEO

choice TOUCHPANEL_DRIVER
    prompt "Touch panel driver"
    optional

config TOUCH_XPT2046
    bool "XPT2046"

config TOUCH_FT6X06
    bool "ft6x06"

config TOUCH_CST816S
    bool "CST816S"

config TOUCH_STMPE811QTR
    bool "STMPE811QTR"

endchoice

config TOUCHPANEL_DEVICE
    string
    default "XPT2046.cpp"        if TOUCH_XPT2046
    default "ft6x06_I2C.cpp"     if TOUCH_FT6X06
    default "CST816S.cpp"        if TOUCH_CST816S
    default "STMPE811QTR_I2C.cpp" if TOUCH_STMPE811QTR

choice TOUCHPANEL_INTERFACE_CHOICE
    prompt "Touch panel interface"
    optional

config TOUCH_IFACE_SPI
    bool "SPI to Touch Panel"

config TOUCH_IFACE_I2C
    bool "I2C to Touch Panel"

endchoice

config TOUCHPANEL_INTERFACE
    string
    default "Spi_To_TouchPanel.cpp"   if TOUCH_IFACE_SPI
    default "I2C_To_TouchPanel.cpp"   if TOUCH_IFACE_I2C

config GRAPHICS_MEMORY
    string "Graphics memory implementation"
    default ""

endmenu
```
