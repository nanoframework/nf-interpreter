## Kconfig.mcuboot
```kconfig
#
# Copyright (c) .NET Foundation and Contributors
# See LICENSE file in the project root for full license information.
#

menu "MCUboot"

config NF_FEATURE_HAS_MCUBOOT
    bool "Enable MCUboot bootloader integration"
    default n
    depends on !NF_TARGET_HAS_NANOBOOTER
    help
        Enable MCUboot as the bootloader for this target. MCUboot and
        nanoBooter are mutually exclusive — only one bootloader may be
        active at a time. Enabling this option is only possible when
        NF_TARGET_HAS_NANOBOOTER is disabled.

        MCUboot provides signed-image verification and In-Field Update
        (IFU) with rollback support. When enabled, the firmware is built
        with MCUboot image headers and the flash area backend is wired to
        the MCUboot porting layer.

choice NF_MCUBOOT_UPGRADE_STRATEGY
    prompt "Upgrade strategy"
    depends on NF_FEATURE_HAS_MCUBOOT
    default NF_MCUBOOT_SWAP_USING_MOVE
    help
        Selects the MCUboot image upgrade algorithm. Exactly one strategy must
        be chosen per target. The correct choice depends on whether the secondary
        slot resides in internal or external flash.

config NF_MCUBOOT_SWAP_USING_OFFSET
    bool "Swap using offset"
    help
        Primary slot is in internal flash; secondary slot is on external storage
        (QSPI flash, SD card, or USB MSD). MCUboot copies the new image sector
        by sector from secondary to primary using the offset variant, which does
        not require a separate scratch partition. Recommended for STM32 targets.

config NF_MCUBOOT_SWAP_USING_MOVE
    bool "Swap using move"
    help
        Both slots reside in internal flash. MCUboot moves sectors without a
        dedicated scratch partition (slot sizes must be equal and aligned).
        Recommended for ESP32 targets.

config NF_MCUBOOT_OVERWRITE_ONLY
    bool "Overwrite only (no rollback)"
    help
        The new image overwrites the primary slot directly. No rollback is
        possible after a successful upgrade. Use only on targets with no
        secondary storage.

endchoice # NF_MCUBOOT_UPGRADE_STRATEGY

config NF_MCUBOOT_IMAGE_NUMBER
    int "Number of managed images"
    depends on NF_FEATURE_HAS_MCUBOOT
    range 1 2
    default 2
    help
        Number of independently managed MCUboot images.
        2 (default): Image 0 = nanoCLR firmware, Image 1 = deployment area.
        Both images can be upgraded and rolled back independently.

config NF_MCUBOOT_SERIAL_RECOVERY
    bool "Enable serial recovery mode"
    depends on NF_FEATURE_HAS_MCUBOOT
    default n
    help
        Enable MCUboot serial recovery (SMP/mcumgr over ChibiOS stream). When
        triggered at boot by asserting the board's recovery GPIO, MCUboot enters
        a receive loop that accepts new images via the mcumgr image upload command
        (group 1, cmd 1) over UART or USB CDC.

        The transport channel is board-specific: USB CDC boards return &SDU1
        from mcuboot_serial_get_channel(); UART boards return &SD1 (or similar).
        Only the image upload group is compiled in; image-state, hash, and
        slot-info groups are disabled to minimise flash usage.

config NF_MCUBOOT_SERIAL_DETECT_DELAY_MS
    int "Serial recovery detect delay (ms)"
    depends on NF_MCUBOOT_SERIAL_RECOVERY
    default 100
    range 1 5000
    help
        Time in milliseconds to wait after reset before sampling the recovery
        GPIO. This provides hardware debounce for the detect pin. The default
        100 ms is sufficient for most push-buttons.

choice NF_MCUBOOT_LOG_LEVEL
    prompt "Log level"
    depends on NF_FEATURE_HAS_MCUBOOT
    default NF_MCUBOOT_LOG_LEVEL_OFF
    help
        Verbosity of MCUboot bootloader log output. Each level includes all
        higher-priority levels (e.g. INFO includes ERROR and WARNING).

        The log backend is the board-supplied nf_mcuboot_log_write() function.
        The weak default is a no-op; boards that want output override it in
        their MCUboot BSP file (e.g. to route messages via chprintf to UART or
        USB CDC).

        Select OFF for production builds to minimise flash usage.

config NF_MCUBOOT_LOG_LEVEL_OFF
    bool "Off"
    help
        No logging output. All BOOT_LOG_* calls compile to nothing.

config NF_MCUBOOT_LOG_LEVEL_ERROR
    bool "Error"
    help
        BOOT_LOG_ERR() messages only.

config NF_MCUBOOT_LOG_LEVEL_WARNING
    bool "Warning"
    help
        BOOT_LOG_ERR() and BOOT_LOG_WRN() messages.

config NF_MCUBOOT_LOG_LEVEL_INFO
    bool "Info"
    help
        BOOT_LOG_ERR(), BOOT_LOG_WRN(), and BOOT_LOG_INF() messages.

config NF_MCUBOOT_LOG_LEVEL_DEBUG
    bool "Debug"
    help
        All BOOT_LOG_* messages, including BOOT_LOG_DBG().

endchoice # NF_MCUBOOT_LOG_LEVEL

config NF_MCUBOOT_HEADER_SIZE
    hex "MCUboot image header size (bytes)"
    depends on NF_FEATURE_HAS_MCUBOOT
    default 0x200
    help
        Size in bytes reserved for the MCUboot image header at the start of
        each firmware slot. This value must match both the flash layout
        (reserved header area) and the imgtool sign --header-size argument.
        0x200 (512 bytes) is the standard value for all current nanoFramework
        targets. Override only if a specific target's flash layout requires a
        different alignment.

config NF_FEATURE_MCUBOOT_HAS_SDCARD
    bool "Enable SD card (FatFs) support in MCUboot"
    depends on NF_FEATURE_HAS_MCUBOOT
    default n
    help
        Include the ChibiOS SDC driver and FatFs library in the MCUboot
        bootloader build. Required when the secondary image slot(s) reside
        on an SD card accessed via FatFs files. The target's existing
        ffconf.h is reused so that the same FatFs configuration applies
        to both the bootloader and the nanoCLR runtime.

config NF_MCUBOOT_LOGICAL_SECTOR_SIZE
    hex "MCUboot size of a logical sector"
    depends on NF_FEATURE_HAS_MCUBOOT
    default 0x0
    help
        Set to 0x0 to use hardware sectors. Any other value here should be aligned to hardware
        sectors in size and alignment, and must be a power of two. A build time assertion
        rejects sizes that are not, as offsets are rounded by masking rather than by division.

config NF_MCUBOOT_VERIFY_LOGICAL_SECTORS
	bool "Validate logical sector layout"
	depends on NF_MCUBOOT_LOGICAL_SECTOR_SIZE != 0x0
	help
	  Validation of logical sector size against hardware constraints. Should be used to
	  validate compile-time configuration against run-time system.

endmenu # MCUboot
```

## Kconfig.networking
```kconfig
#
# Copyright (c) .NET Foundation and Contributors
# See LICENSE file in the project root for full license information.
#

menu "Networking"
    depends on API_SYSTEM_NET

config NF_NETWORKING_SNTP
    bool "SNTP support"
    default y

config NF_NETWORKING_ENC28J60
    bool "ENC28J60 SPI Ethernet driver"
    default n

endmenu
```

## Kconfig.rtos
```kconfig
#
# Copyright (c) .NET Foundation and Contributors
# See LICENSE file in the project root for full license information.
#

choice RTOS_CHOICE
    prompt "RTOS"

config RTOS_ESP32
    bool "ESP32 (ESP-IDF FreeRTOS)"

config RTOS_CHIBIOS
    bool "ChibiOS"

config RTOS_FREERTOS
    bool "FreeRTOS"

config RTOS_TI_SIMPLELINK
    bool "TI SimpleLink"

config RTOS_THREADX
    bool "ThreadX"

endchoice

# String variable consumed by CMake
config RTOS
    string
    default "ESP32"        if RTOS_ESP32
    default "ChibiOS"      if RTOS_CHIBIOS
    default "FreeRTOS"     if RTOS_FREERTOS
    default "TI_SimpleLink" if RTOS_TI_SIMPLELINK
    default "ThreadX"      if RTOS_THREADX
```

## Kconfig.wireprotocol
```kconfig
#
# Copyright (c) .NET Foundation and Contributors
# See LICENSE file in the project root for full license information.
#

menu "Wire Protocol"

config NF_WP_IMPLEMENTS_CRC32
    bool "Implement CRC32 for Wire Protocol"
    default n
    help
      Enable CRC32 integrity checking on Wire Protocol packets.
      Slightly increases communication overhead but improves reliability
      on noisy links.

menu "Wire Protocol Trace"

config NF_WP_TRACE_ERRORS
    bool "Trace errors"
    default n
    help
      Log Wire Protocol error conditions. Useful during host-device
      communication debugging.

config NF_WP_TRACE_HEADERS
    bool "Trace packet headers"
    default n
    help
      Log Wire Protocol packet headers.

config NF_WP_TRACE_STATE
    bool "Trace state machine transitions"
    default n

config NF_WP_TRACE_NODATA
    bool "Trace packets with no payload"
    default n

config NF_WP_TRACE_VERBOSE
    bool "Verbose trace (all packets)"
    default n

config NF_WP_TRACE_ALL
    bool "Enable all trace flags"
    default n
    imply NF_WP_TRACE_ERRORS
    imply NF_WP_TRACE_HEADERS
    imply NF_WP_TRACE_STATE
    imply NF_WP_TRACE_NODATA
    imply NF_WP_TRACE_VERBOSE
    help
      Convenience option: enables all individual trace flags above via
      imply. Individual flags can still be overridden independently.

endmenu # Wire Protocol Trace

endmenu # Wire Protocol
```

## targets/ChibiOS/Kconfig
```kconfig
#
# Copyright (c) .NET Foundation and Contributors
# See LICENSE file in the project root for full license information.
#

menu "ChibiOS Platform"
    depends on RTOS_CHIBIOS

config CHIBIOS_CONTRIB_REQUIRED
    bool "ChibiOS Community contributions repository required"
    default n

config SWO_OUTPUT
    bool "ARM Cortex-M Single Wire Output (SWO)"
    default n

endmenu
```

## targets/ChibiOS/RP_PICO_W_RP2040/defconfig
```kconfig
# defconfig for RP_PICO_W_RP2040

CONFIG_API_SYSTEM_DEVICE_ADC=y
CONFIG_API_SYSTEM_DEVICE_GPIO=y
CONFIG_API_SYSTEM_DEVICE_I2C=y
CONFIG_API_SYSTEM_DEVICE_PWM=y
CONFIG_API_SYSTEM_DEVICE_SPI=y
CONFIG_API_SYSTEM_DEVICE_WIFI=y
CONFIG_API_SYSTEM_IO_FILESYSTEM=y
CONFIG_API_SYSTEM_NET=y
CONFIG_API_NANOFRAMEWORK_RESOURCEMANAGER=y
CONFIG_API_NANOFRAMEWORK_SYSTEM_COLLECTIONS=y
CONFIG_API_NANOFRAMEWORK_SYSTEM_TEXT=y
# CONFIG_CHIBIOS_CONTRIB_REQUIRED is not set
# CONFIG_CHIBIOS_SWO_OUTPUT is not set
# CONFIG_NF_BUILD_RTM is not set
CONFIG_NF_FEATURE_DEBUGGER=y
CONFIG_NF_FEATURE_HAS_ACCESSIBLE_STORAGE=y
CONFIG_NF_FEATURE_HAS_CONFIG_BLOCK=y
CONFIG_NF_FEATURE_LIGHT_MATH=y
CONFIG_NF_FEATURE_RTC=y
CONFIG_NF_FEATURE_USE_LITTLEFS=y
# CONFIG_NF_FEATURE_USE_RNG is not set
CONFIG_NF_SECURITY_MBEDTLS=y
# CONFIG_NF_SUPPORT_ANY_BASE_CONVERSION is not set
CONFIG_RTOS_CHIBIOS=y
# CONFIG_STM32_CUBE_PACKAGE_REQUIRED is not set
CONFIG_TARGET_BOARD="RP_PICO_W_RP2040"
CONFIG_TARGET_HAS_WIFI=y
CONFIG_TARGET_SERIES="RP2040"
```

## targets/ESP32/Kconfig
```kconfig
#
# Copyright (c) .NET Foundation and Contributors
# See LICENSE file in the project root for full license information.
#

menu "ESP32 Platform"
    depends on RTOS_ESP32

config SDK_CONFIG_FILE
    string "ESP-IDF sdkconfig defaults file"
    default ""
    help
      Relative path to the IDF sdkconfig defaults file.
      Leave empty to use targets/ESP32/_IDF/sdkconfig.default.

config ESP32_RESERVE_SPIRAM_IDF_ALLOCATION_BYTES
    int "SPIRAM reserved for IDF allocation (bytes)"
    default 262144
    help
      Amount of SPIRAM to reserve for ESP-IDF internal allocations.
      Typical values: 262144 (256KB), 1048576 (1MB).

config ESP32_RESERVE_IRAM_IDF_ALLOCATION_KB
    int "Internal RAM reserved for IDF allocation (kB)"
    default 0
    help
      Amount of internal RAM (in kB) to reserve for ESP-IDF allocations.
      Used on boards with limited memory (e.g., ESP32-PICO, M5StickC).

config ESP32_USB_CDC
    bool "USB CDC for Wire Protocol"
    default n

config ESP32_XTAL_FREQ_26
    bool "26 MHz crystal (instead of 40 MHz default)"
    default n

config ESP32_THREAD_DEVICE_TYPE
    string "Thread device type"
    default ""
    depends on API_NANOFRAMEWORK_NETWORKING_THREAD
    help
      Thread device type identifier (e.g., "FTD" for Full Thread Device).

config ESP32_ETHERNET_PHY_CLOCK_MODE
    string "Ethernet PHY clock mode override"
    default ""

config ESP32_ETHERNET_PHY_POWER_PIN
    string "Ethernet PHY power pin override"
    default ""

source "targets/ESP32/Kconfig.ethernet"

endmenu
```

## targets/ESP32/Kconfig.ethernet
```kconfig
#
# Copyright (c) .NET Foundation and Contributors
# See LICENSE file in the project root for full license information.
#

menu "ESP32 Ethernet"
    depends on RTOS_ESP32

config ESP32_ETHERNET_SUPPORT
    bool "Enable Ethernet support"
    default n

if ESP32_ETHERNET_SUPPORT

#
# Mutually exclusive Ethernet interface selection
#
choice ESP32_ETHERNET_INTERFACE_CHOICE
    prompt "Ethernet PHY interface type"
    default ESP32_ETHERNET_PHY_LAN8720

config ESP32_ETHERNET_PHY_IP101
    bool "Internal PHY: IP101"

config ESP32_ETHERNET_PHY_LAN8720
    bool "Internal PHY: LAN8720"

config ESP32_ETHERNET_PHY_RTL8201
    bool "Internal PHY: RTL8201"

config ESP32_ETHERNET_SPI
    bool "External SPI Ethernet module"
    help
        Use an external SPI-based Ethernet controller.
        This disables all internal RMII/MII PHY settings.

endchoice

#
# Interface string (used by CMake / C code)
#
config ESP32_ETHERNET_INTERFACE
    string
    default "IP101"   if ESP32_ETHERNET_PHY_IP101
    default "LAN8720" if ESP32_ETHERNET_PHY_LAN8720
    default "RTL8201" if ESP32_ETHERNET_PHY_RTL8201
    default "SPI"     if ESP32_ETHERNET_SPI

#
# Internal PHY settings (hidden when SPI is selected)
#
config ESP32_ETHERNET_PHY_ADDR
    int "Ethernet PHY address"
    range 0 31
    default 0
    depends on !ESP32_ETHERNET_SPI

config ESP32_ETHERNET_MDC_GPIO
    int "MDC GPIO pin"
    default 23
    depends on !ESP32_ETHERNET_SPI

config ESP32_ETHERNET_MDIO_GPIO
    int "MDIO GPIO pin"
    default 18
    depends on !ESP32_ETHERNET_SPI

config ESP32_ETHERNET_RMII_CLK_OUT_GPIO
    int "RMII clock output GPIO pin (-1 to disable)"
    default -1
    depends on !ESP32_ETHERNET_SPI

config ESP32_ETHERNET_RMII_CLK_IN_GPIO
    int "RMII clock input GPIO pin (-1 to disable)"
    default -1
    depends on !ESP32_ETHERNET_SPI

config ESP32_ETHERNET_PHY_RST_GPIO
    int "Ethernet PHY reset GPIO pin (-1 to disable)"
    default -1
    depends on !ESP32_ETHERNET_SPI

#
# SPI Ethernet configuration (only visible when SPI is selected)
#
menu "SPI Ethernet configuration"
    depends on ESP32_ETHERNET_SPI

choice ESP32_ETHERNET_SPI_MODULE
    prompt "SPI Ethernet module"
    default ESP32_ETHERNET_SPI_MODULE_W5500

config ESP32_ETHERNET_SPI_MODULE_DM9051
    bool "DM9051"

config ESP32_ETHERNET_SPI_MODULE_W5500
    bool "W5500"

config ESP32_ETHERNET_SPI_MODULE_ENJ28J60
    bool "ENJ28J60"

endchoice

config ESP32_ETHERNET_SPI_HOST
    int "SPI host (2 = SPI2_HOST, 3 = SPI3_HOST)"
    range 2 3
    default 2

config ESP32_ETHERNET_SPI_CLOCK_MHZ
    int "SPI clock speed (MHz)"
    default 8

config ESP32_ETHERNET_SPI_CS_GPIO
    int "SPI CS pin"
    default 5

config ESP32_ETHERNET_SPI_INT_GPIO
    int "SPI interrupt pin"
    default 16

config ESP32_ETHERNET_SPI_RST_GPIO
    int "SPI reset pin"
    default 17

config ESP32_ETHERNET_SPI_MISO_GPIO
    int "SPI MISO pin"
    default 23

config ESP32_ETHERNET_SPI_MOSI_GPIO
    int "SPI MOSI pin"
    default 18

config ESP32_ETHERNET_SPI_SCLK_GPIO
    int "SPI SCLK pin"
    default 19

endmenu # SPI Ethernet configuration

endif # ESP32_ETHERNET_SUPPORT

endmenu
```

## targets/FreeRTOS/Kconfig
```kconfig
#
# Copyright (c) .NET Foundation and Contributors
# See LICENSE file in the project root for full license information.
#

menu "FreeRTOS Platform"
    depends on RTOS_FREERTOS

endmenu
```
