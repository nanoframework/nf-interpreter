/*
 * Copyright (c) 2021 Nordic Semiconductor ASA
 *
 * SPDX-License-Identifier: LicenseRef-Nordic-5-Clause
 */

/* Enable uart1. 
	compatible = "nordic,nrf-uarte";
	current-speed = <921600>;
 */
&uart1 {
	status = "okay";
};
