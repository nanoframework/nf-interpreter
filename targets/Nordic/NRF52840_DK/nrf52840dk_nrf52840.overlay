//
// Copyright (c) .NET Foundation and Contributors
// Portions Copyright (c) 2021 Nordic Semiconductor ASA
// See LICENSE file in the project root for full license information.
//


// Enable uart1. 
//	compatible = "nordic,nrf-uarte";
//	current-speed = <921600>;

&uart1 {
	status = "okay";
};
