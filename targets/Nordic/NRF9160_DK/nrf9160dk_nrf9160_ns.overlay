//
// Copyright (c) .NET Foundation and Contributors
// Portions Copyright (c) 2021 Nordic Semiconductor ASA
// See LICENSE file in the project root for full license information.
//

// Enable uart1
// It appears that only 115200 works when piping through the 52840
// current-speed = <921600>;
&uart1 {
	compatible = "nordic,nrf-uarte";
	current-speed = <115200>;
	status = "okay";
};
