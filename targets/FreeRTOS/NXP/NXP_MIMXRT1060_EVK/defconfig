## targets/Nordic/_nanoCLR_module/Kconfig
```kconfig
#
#
#

config NANOFRAMEWORK_LIB
	bool "nanoFramework library"
	# Since minimal libc lacks sscanf and strtod we need to use newlibc
	# Allow external libc to allow native posix to be used for unit test
	depends on NEWLIB_LIBC 
```

## targets/Nordic/_zephyr_boards/boards/arm/nrf9160_ard0022B/Kconfig.defconfig
```kconfig
# Copyright (c) .NET Foundation and Contributors
# Portions Copyright (c) 2018 Nordic Semiconductor ASA
# Portions Copyright (c) Ericsson AB 2020, all rights reserved
# See LICENSE file in the project root for full license information.

if BOARD_NRF9160_ARD0022B || BOARD_NRF9160_ARD0022BNS

config BOARD
	default "nrf9160_ard0022B"

if ADC

config ADC_0
	bool
	default y

endif # ADC

if I2C

config I2C_2
	bool
	default y

endif # I2C

if PWM

config PWM_0
	bool
	default y

endif # PWM

if SPI

config SPI_3
	bool
	default y

config SPI_NOR
	bool
	default y

endif # SPI

# For the secure version of the board the firmware is linked at the beginning
# of the flash, or into the code-partition defined in DT if it is intended to
# be loaded by MCUboot. If the secure firmware is to be combined with a non-
# secure image (TRUSTED_EXECUTION_SECURE=y), the secure FW image shall always
# be restricted to the size of its code partition.
# For the non-secure version of the board, the firmware
# must be linked into the code-partition (non-secure) defined in DT, regardless.
# Apply this configuration below by setting the Kconfig symbols used by
# the linker according to the information extracted from DT partitions.

if BOARD_NRF9160_ARD0022B && TRUSTED_EXECUTION_SECURE

config FLASH_LOAD_SIZE
	default $(dt_chosen_reg_size_hex,$(DT_CHOSEN_Z_CODE_PARTITION))

endif # BOARD_NRF9160_ARD0022B && TRUSTED_EXECUTION_SECURE

if BOARD_NRF9160_ARD0022BNS

config FLASH_LOAD_OFFSET
	default $(dt_chosen_reg_addr_hex,$(DT_CHOSEN_Z_CODE_PARTITION))

config FLASH_LOAD_SIZE
	default $(dt_chosen_reg_size_hex,$(DT_CHOSEN_Z_CODE_PARTITION))

endif # BOARD_NRF9160_ARD0022BNS

endif # BOARD_NRF9160_ARD0022B || BOARD_NRF9160_ARD0022BNS
```

## targets/Nordic/_zephyr_boards/boards/arm/nrf9160_ard0022B/nrf9160_ard0022B_ns_defconfig
```kconfig
# Copyright (c) .NET Foundation and Contributors
# Portions Copyright (c) Ericsson AB 2020, all rights reserved
# See LICENSE file in the project root for full license information.

CONFIG_SOC_SERIES_NRF91X=y
CONFIG_SOC_NRF9160_SICA=y
CONFIG_BOARD_NRF9160_ARD0022B_NS=y

# Enable MPU
CONFIG_ARM_MPU=y

# Needed for v1.6
CONFIG_FPU=y

# Needed for v2.0
CONFIG_PINCTRL=y

# v2.0 MAGPIO config now done in a library
CONFIG_MODEM_ANTENNA=y
CONFIG_MODEM_ANTENNA_AT_MAGPIO="AT\%XMAGPIO=1,1,1,9,1,698,728,3,729,757,5,758,820,6,815,862,2,859,895,0,896,980,1,1559,1916,3,1917,2100,6,2101,2200"
CONFIG_MODEM_ANTENNA_AT_COEX0="AT\%XCOEX0=1,1,1570,1580"

# Enable TrustZone-M
CONFIG_ARM_TRUSTZONE_M=y

# This Board implies building Non-Secure firmware
CONFIG_TRUSTED_EXECUTION_NONSECURE=y

# Enable GPIO
CONFIG_GPIO=y

# Enable UARTE
CONFIG_SERIAL=y

# Enable console
CONFIG_CONSOLE=y
CONFIG_UART_CONSOLE=y

# Enable I2C
CONFIG_I2C=y

# Enable SPI
CONFIG_SPI=y
#CONFIG_SPI_3=y

# Disable default power management driver for IC ADP536x
CONFIG_ADP536X=n

# Disable entropy driver, as it's not yet implemented for nRF9160
CONFIG_ENTROPY_NRF5_RNG=n

# Select default sensors here. These can be
# overridden in the prj file for an individual application.
CONFIG_SENSOR=y
CONFIG_BME680=y

CONFIG_ADXL362=y
CONFIG_ADXL362_TRIGGER_GLOBAL_THREAD=y
CONFIG_ADXL362_INTERRUPT_MODE=1
CONFIG_ADXL362_ABS_REF_MODE=1

CONFIG_ADXL372=y
CONFIG_ADXL372_TRIGGER_GLOBAL_THREAD=y
CONFIG_ADXL372_SPI=y
CONFIG_ADXL372_MEASUREMENT_MODE=y

CONFIG_BH1749=n
```

## targets/Nordic/boards/arm/nrf9160_ard0022B/Kconfig
```kconfig
# Copyright (c) .NET Foundation and Contributors
# Portions Copyright (c) 2018 Nordic Semiconductor ASA
# Portions Copyright (c) Ericsson AB 2020, all rights reserved
# See LICENSE file in the project root for full license information.

# Kconfig - nRF91 PCA20035 board configuration

module=BOARD
module-dep=LOG
module-str=Log level for board
source "${ZEPHYR_BASE}/subsys/logging/Kconfig.template.log_config"
```

## targets/Nordic/boards/arm/nrf9160_ard0022B/Kconfig.board
```kconfig
# Copyright (c) .NET Foundation and Contributors
# Portions Copyright (c) 2018 Nordic Semiconductor ASA
# Portions Copyright (c) Ericsson AB 2020, all rights reserved
# See LICENSE file in the project root for full license information.

# Kconfig - nRF91 Combi Dev board configuration

if SOC_NRF9160_SICA

config BOARD_NRF9160_ARD0022B
	bool "nRF9160 ARD0022B"
	depends on !TRUSTED_EXECUTION_NONSECURE

config BOARD_NRF9160_ARD0022BNS
	bool "nRF9160 ARD0022B non-secure"
	depends on TRUSTED_EXECUTION_NONSECURE

endif # SOC_NRF9160_SICA


#if CONFIG_SENSOR

menu "Accel"
config ACCEL_DEV_NAME
	string "Accelerometer device name"
	default "ADXL362" 
	help
		Device from which accelerometer data will be fetched and used
		for orientation detection and sent to nRF Cloud.
endmenu # Accel
	
menu "Environment sensors"		

config TEMP_DEV_NAME
	string "Temperature device name"
	default "BME680" 

config USE_BME680_BSEC
	bool "Use Bosch BME680 BSEC lib"
	default n
	help
	  Enable use of Bosch BSEC library. The library itself is not a part of
	  NCS and must be downloaded from Bosch Sensortec.

config BOSCH_BSEC_LIBRARY_PATH
	string "Path to Bosch BSEC library folder"
	default "$(ZEPHYR_BASE)/../nrf/ext/BSEC_1.4.7.4_Generic_Release"
	help
	  Path to the folder where the Bosch BSEC library is placed.

endmenu # Environment sensors

menu "Light"

config 	LIGHT_SENSOR
	bool "Light sensor"
	select BH1749 
	default n

config LIGHT_SENSOR_DEV_NAME
	string "Light sensor device name"
	default "BH1749" 

endmenu #Light

#endif
```

## targets/Nordic/boards/arm/nrf9160_ard0022B/nrf9160_ard0022B_defconfig
```kconfig
#
# Copyright (c) Ericsson AB 2020, all rights reserved
#
CONFIG_SOC_SERIES_NRF91X=y
CONFIG_SOC_NRF9160_SICA=y
CONFIG_BOARD_NRF9160_ARD0022B=y

# Enable MPU
CONFIG_ARM_MPU=y

# Needed for v2.0
CONFIG_PINCTRL=y

# Enable TrustZone-M
CONFIG_ARM_TRUSTZONE_M=y

# Enable GPIO
CONFIG_GPIO=y

CONFIG_SERIAL=n
# Enable console
CONFIG_CONSOLE=n
CONFIG_UART_CONSOLE=n
#(db) end of change.


# Enable I2C
CONFIG_I2C=y

# Enable power management IC ADP536x
CONFIG_ADP536X=y

# Disable entropy driver, as it's not yet implemented for nRF9160
CONFIG_ENTROPY_NRF5_RNG=n

# Enlarge the secure boot partition. Needed for v1.5 support
CONFIG_PM_PARTITION_SIZE_SPM=0x10000
```

## targets/TI_SimpleLink/Kconfig
```kconfig
#
# Copyright (c) .NET Foundation and Contributors
# See LICENSE file in the project root for full license information.
#

menu "TI SimpleLink Platform"
    depends on RTOS_TI_SIMPLELINK

config TI_SIMPLELINK_RADIO_FREQ_MHZ
    int "Radio frequency (868 or 915 MHz)"
    default 915
    help
      Radio frequency for TI CC13xx devices.
      Valid values are 868 and 915.

endmenu
```

## targets/ThreadX/Kconfig
```kconfig
#
# Copyright (c) .NET Foundation and Contributors
# See LICENSE file in the project root for full license information.
#

menu "ThreadX Platform"
    depends on RTOS_THREADX

config THREADX_CHIBIOS_HAL_REQUIRED
    bool "ChibiOS HAL required (for STM32 WiFi targets)"
    default n

config THREADX_WIFI_DRIVER
    string "WiFi driver name"
    default ""

config STM32_CUBE_PACKAGE_REQUIRED
    bool "STM32 Cube package required"
    default n

endmenu

source "targets/ThreadX/SiliconLabs/Kconfig"
```

## targets/ThreadX/SiliconLabs/Kconfig
```kconfig
#
# Copyright (c) .NET Foundation and Contributors
# See LICENSE file in the project root for full license information.
#

menu "Silicon Labs / Gecko SDK"
    depends on RTOS_THREADX

config GECKO_FEATURE_USBD_HID
    bool "Gecko USB HID device class support"
    default n

config GECKO_FEATURE_USBD_WINUSB
    bool "Gecko USB WinUSB (vendor class) device support"
    default y if API_SYSTEM_DEVICE_USBSTREAM
    default n

endmenu
```
