/**
 * @cliArgs --board "/ti/boards/CC1352R1_LAUNCHXL" --product "simplelink_cc13x2_26x2_sdk@4.20.01.04"
 * @versions {"data":"2020090214","timestamp":"2020090214","tool":"1.6.0+1543","templates":"2020090214"}
 */

/**
 * Import the modules used in this configuration.
 */
const CCFG     = scripting.addModule("/ti/devices/CCFG");
const ADC      = scripting.addModule("/ti/drivers/ADC", {}, false);
const ADC1     = ADC.addInstance();
const DMA      = scripting.addModule("/ti/drivers/DMA");
const RTOS     = scripting.addModule("/ti/drivers/RTOS");
const UART2    = scripting.addModule("/ti/drivers/UART2", {}, false);
const UART21   = UART2.addInstance();
const easylink = scripting.addModule("/ti/easylink/easylink");

/**
 * Write custom configuration values to the imported modules.
 */
CCFG.forceVddr          = true;
CCFG.ccfgTemplate.$name = "ti_devices_CCFGTemplate0";

ADC1.$name                = "ADC_0";
ADC1.samplingDuration     = "170 us";
ADC1.adcPinInstance.$name = "CONFIG_PIN_0";

UART21.$hardware           = system.deviceData.board.components.XDS110UART;
UART21.$name               = "UART0";
UART21.txPinInstance.$name = "CONFIG_PIN_2";
UART21.rxPinInstance.$name = "CONFIG_PIN_3";
UART21.uart.$assign        = "UART0";

easylink.EasyLink_Phy_5kbpsSlLr                                    = true;
easylink.defaultPhy                                                = "EasyLink_Phy_5kbpsSlLr";
easylink.EasyLink_Phy_50kbps2gfsk                                  = true;
easylink.EasyLink_Phy_200kbps2gfsk                                 = true;
easylink.EasyLink_Phy_Custom                                       = false;
easylink.addrFilters                                               = "";
easylink.enableAddrFilter                                          = false;
easylink.radioConfigEasylinkPhy5kbpssllr.codeExportConfig.$name    = "ti_devices_radioconfig_code_export_param1";
easylink.radioConfigEasylinkPhy50kbps2gfsk.codeExportConfig.$name  = "ti_devices_radioconfig_code_export_param2";
easylink.radioConfigEasylinkPhy200kbps2gfsk.codeExportConfig.$name = "ti_devices_radioconfig_code_export_param3";

/**
 * Pinmux solution for unlocked pins/peripherals. This ensures that minor changes to the automatic solver in a future
 * version of the tool will not impact the pinmux you originally saw.  These lines can be completely deleted in order to
 * re-solve from scratch.
 */
ADC1.adc.$suggestSolution          = "ADC0";
ADC1.adc.adcPin.$suggestSolution   = "boosterpack.2";
UART21.uart.txPin.$suggestSolution = "boosterpack.4";
UART21.uart.rxPin.$suggestSolution = "boosterpack.3";
