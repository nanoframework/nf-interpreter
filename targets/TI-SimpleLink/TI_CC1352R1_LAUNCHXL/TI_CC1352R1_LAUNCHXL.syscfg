/**
 * @cliArgs --board "/ti/boards/CC1352R1_LAUNCHXL" --product "simplelink_cc13x2_26x2_sdk@4.20.01.04"
 * @versions {"data":"2020052512","timestamp":"2020052512","tool":"1.5.0+1397","templates":"2020052512"}
 */

/**
 * Import the modules used in this configuration.
 */
const CCFG     = scripting.addModule("/ti/devices/CCFG");
const DMA      = scripting.addModule("/ti/drivers/DMA");
const RTOS     = scripting.addModule("/ti/drivers/RTOS");
const UART     = scripting.addModule("/ti/drivers/UART", {}, false);
const UART1    = UART.addInstance();
const easylink = scripting.addModule("/ti/easylink/easylink");

/**
 * Write custom configuration values to the imported modules.
 */
CCFG.forceVddr          = true;
CCFG.ccfgTemplate.$name = "ti_devices_CCFGTemplate0";

UART1.$hardware           = system.deviceData.board.components.XDS110UART;
UART1.$name               = "UART0";
UART1.txPinInstance.$name = "CONFIG_PIN_0";
UART1.rxPinInstance.$name = "CONFIG_PIN_1";
UART1.uart.$assign        = "UART0";

easylink.EasyLink_Phy_5kbpsSlLr                                    = true;
easylink.defaultPhy                                                = "EasyLink_Phy_5kbpsSlLr";
easylink.EasyLink_Phy_50kbps2gfsk                                  = true;
easylink.EasyLink_Phy_200kbps2gfsk                                 = true;
easylink.enableAddrFilter                                          = false;
easylink.radioConfigEasylinkPhyCustom.codeExportConfig.$name       = "ti_devices_radioconfig_code_export_param0";
easylink.radioConfigEasylinkPhy5kbpssllr.codeExportConfig.$name    = "ti_devices_radioconfig_code_export_param1";
easylink.radioConfigEasylinkPhy50kbps2gfsk.codeExportConfig.$name  = "ti_devices_radioconfig_code_export_param2";
easylink.radioConfigEasylinkPhy200kbps2gfsk.codeExportConfig.$name = "ti_devices_radioconfig_code_export_param3";

/**
 * Pinmux solution for unlocked pins/peripherals. This ensures that minor changes to the automatic solver in a future
 * version of the tool will not impact the pinmux you originally saw.  These lines can be completely deleted in order to
 * re-solve from scratch.
 */
UART1.uart.txPin.$suggestSolution = "boosterpack.4";
UART1.uart.rxPin.$suggestSolution = "boosterpack.3";
