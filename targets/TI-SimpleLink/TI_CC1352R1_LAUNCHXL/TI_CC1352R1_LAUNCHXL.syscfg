/**
 * These arguments were used when this file was generated. They will be automatically applied on subsequent loads
 * via the GUI or CLI. Run CLI with '--help' for additional information on how to override these arguments.
 * @cliArgs --board "/ti/boards/CC1352R1_LAUNCHXL" --product "simplelink_cc13x2_26x2_sdk@4.20.01.04"
 * @versions {"data":"2020052512","timestamp":"2020052512","tool":"1.5.0+1397","templates":"2020052512"}
 */

/**
 * Import the modules used in this configuration.
 */
const CCFG     = scripting.addModule("/ti/devices/CCFG");
const DMA      = scripting.addModule("/ti/drivers/DMA");
const RTOS     = scripting.addModule("/ti/drivers/RTOS");
const UART     = scripting.addModule("/ti/drivers/UART", {}, false);
const UART1    = UART.addInstance();
const Button   = scripting.addModule("/ti/drivers/apps/Button", {}, false);
const Button1  = Button.addInstance();
const Button2  = Button.addInstance();
const LED      = scripting.addModule("/ti/drivers/apps/LED", {}, false);
const LED1     = LED.addInstance();
const LED2     = LED.addInstance();
const easylink = scripting.addModule("/ti/easylink/easylink");

/**
 * Write custom configuration values to the imported modules.
 */
CCFG.forceVddr          = true;
CCFG.ccfgTemplate.$name = "ti_devices_CCFGTemplate0";

UART1.$name               = "UART0";
UART1.$hardware           = system.deviceData.board.components.XDS110UART;
UART1.txPinInstance.$name = "CONFIG_PIN_0";
UART1.rxPinInstance.$name = "CONFIG_PIN_1";

Button1.$hardware                 = system.deviceData.board.components["BTN-1"];
Button1.$name                     = "CONFIG_BUTTON_1";
Button1.gpioPin.$name             = "CONFIG_GPIO_0";
Button1.gpioPin.pinInstance.$name = "CONFIG_PIN_4";

Button2.$hardware                 = system.deviceData.board.components["BTN-2"];
Button2.$name                     = "CONFIG_BUTTON_2";
Button2.gpioPin.$name             = "CONFIG_GPIO_1";
Button2.gpioPin.pinInstance.$name = "CONFIG_PIN_5";

LED1.$hardware                 = system.deviceData.board.components.LED_RED;
LED1.$name                     = "CONFIG_GPIO_RLED";
LED1.gpioPin.pinInstance.$name = "CONFIG_PIN_2";

LED2.$name                     = "CONFIG_GPIO_GLED";
LED2.$hardware                 = system.deviceData.board.components.LED_GREEN;
LED2.gpioPin.pinInstance.$name = "CONFIG_PIN_3";

easylink.EasyLink_Phy_5kbpsSlLr                                    = true;
easylink.defaultPhy                                                = "EasyLink_Phy_5kbpsSlLr";
easylink.EasyLink_Phy_50kbps2gfsk                                  = true;
easylink.EasyLink_Phy_200kbps2gfsk                                 = true;
easylink.enableAddrFilter                                          = false;
easylink.radioConfigEasylinkPhyCustom.codeExportConfig.$name       = "ti_devices_radioconfig_code_export_param0";
easylink.radioConfigEasylinkPhy5kbpssllr.codeExportConfig.$name    = "ti_devices_radioconfig_code_export_param1";
easylink.radioConfigEasylinkPhy50kbps2gfsk.codeExportConfig.$name  = "ti_devices_radioconfig_code_export_param2";
easylink.radioConfigEasylinkPhy200kbps2gfsk.codeExportConfig.$name = "ti_devices_radioconfig_code_export_param3";

/**
 * Pinmux solution for unlocked pins/peripherals. This ensures that minor changes to the automatic solver in a future
 * version of the tool will not impact the pinmux you originally saw.  These lines can be completely deleted in order to
 * re-solve from scratch.
 */
UART1.uart.$suggestSolution              = "UART0";
UART1.uart.txPin.$suggestSolution        = "boosterpack.4";
UART1.uart.rxPin.$suggestSolution        = "boosterpack.3";
Button1.gpioPin.gpioPin.$suggestSolution = "boosterpack.13";
Button2.gpioPin.gpioPin.$suggestSolution = "boosterpack.12";
LED1.gpioPin.gpioPin.$suggestSolution    = "boosterpack.39";
LED2.gpioPin.gpioPin.$suggestSolution    = "boosterpack.40";
